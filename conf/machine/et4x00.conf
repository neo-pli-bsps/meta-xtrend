## conf/machine/et4x00.conf
```bitbake
#@TYPE: Machine
#@NAME: et4000
#@DESCRIPTION: Machine configuration for the et4000

MKUBIFS_ARGS = "-m 2048 -e 126976 -c 4096"
UBINIZE_ARGS = "-m 2048 -p 128KiB"

DEFAULTTUNE = "mips32el-nf"

MACHINE_FEATURES += " wifi-kernel4 nofhdskin RCA SCART"
DISTRO_FEATURES_remove = "x11 wayland directfb"

CHIPSET = "bcm7358"
RCTYPE = "13"

PREFERRED_VERSION_linux-et = "4.10.6"
require conf/machine/include/et-mipsel.inc

SOC_FAMILY = "bcm7358"

RCNAME = "et4x00"

STB_PLATFORM = "2genxt"
```

## conf/machine/et7x00.conf
```bitbake
#@TYPE: Machine
#@NAME: et7000
#@DESCRIPTION: Machine configuration for the et7000

MACHINE_FEATURES += " textlcd dvb-c et-nextv-blindscan-dvbc SCART YUV"
OPENPLI_FEATURES += " ci"
DISTRO_FEATURES_remove = "x11 wayland directfb"

MKUBIFS_ARGS = "-m 2048 -e 126976 -c 8192"
UBINIZE_ARGS = "-m 2048 -p 128KiB"

CHIPSET = "bcm7362"

PREFERRED_VERSION_linux-et-nextv = "4.4.8"
require conf/machine/include/et-nextv-mipsel.inc

SOC_FAMILY = "bcm7362"

RCNAME = "et7x00"

STB_PLATFORM = "7genxt"
```

## conf/machine/et8500.conf
```bitbake
#@TYPE: Machine
#@NAME: et8500
#@DESCRIPTION: Machine configuration for the et8500

MACHINE_FEATURES += " dvb-c et-nextv-blindscan-dvbc colorlcd720 RCA "
OPENPLI_FEATURES += " ci"
DISTRO_FEATURES_remove = "x11 wayland directfb"

MKUBIFS_ARGS = "-m 2048 -e 126976 -c 8192"
UBINIZE_ARGS = "-m 2048 -p 128KiB"

CHIPSET = "bcm7241"

PREFERRED_VERSION_linux-et-nextv = "4.4.8"
require conf/machine/include/et-nextv-mipsel.inc

SOC_FAMILY = "bcm7241"

RCNAME = "et8000"

STB_PLATFORM = "7genxt"
```
